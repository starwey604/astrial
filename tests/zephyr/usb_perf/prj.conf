## CMakeLists.txt
```
# SPDX-License-Identifier: MIT

cmake_minimum_required(VERSION 3.20.0)
find_package(Zephyr REQUIRED HINTS $ENV{ZEPHYR_BASE})
project(astrial_usb_perf)

target_sources(app PRIVATE src/main.c src/bulk_echo.c)
```

## Kconfig
```
# SPDX-License-Identifier: MIT

# Application-level Kconfig for the Astrial USB performance firmware.
# Deliberately self-contained: this app does not use the Zephyr tree's
# samples/subsys/usb/common Kconfig (sample_usbd).

menu "Astrial USB test options"
	depends on USB_DEVICE_STACK_NEXT

config ASTRIAL_USB_VID
	hex "USB Vendor ID"
	default 0x2fe3
	help
	  Vendor ID the firmware enumerates with. The Astrial performance
	  tools default to 0x2fe3:0x574d. This Zephyr Project VID is acceptable
	  for a lab fixture, never for anything that ships.

config ASTRIAL_USB_PID
	hex "USB Product ID"
	default 0x574d
	help
	  Product ID for the separate performance test device.

config ASTRIAL_USB_MANUFACTURER
	string "Manufacturer string"
	default "Astrial"

config ASTRIAL_USB_PRODUCT
	string "Product string"
	default "Astrial USB Bulk Echo"

endmenu

source "Kconfig.zephyr"
```

## prj.conf
```kconfig
# SPDX-License-Identifier: MIT

CONFIG_USB_DEVICE_STACK_NEXT=y
CONFIG_USBD_MAX_SPEED_HIGH=y
CONFIG_UDC_BUF_POOL_SIZE=16384
CONFIG_LOG=y
```

## src/main.c
```c
/* SPDX-License-Identifier: MIT */

#include <errno.h>
#include <zephyr/kernel.h>
#include <zephyr/logging/log.h>
#include <zephyr/usb/usbd.h>

LOG_MODULE_REGISTER(astrial_usb_perf, LOG_LEVEL_INF);

USBD_DESC_LANG_DEFINE(lang);
USBD_DESC_MANUFACTURER_DEFINE(mfg, CONFIG_ASTRIAL_USB_MANUFACTURER);
USBD_DESC_PRODUCT_DEFINE(product, CONFIG_ASTRIAL_USB_PRODUCT);
USBD_CONFIGURATION_DEFINE(fs_config, USB_SCD_SELF_POWERED, 100, NULL);
USBD_CONFIGURATION_DEFINE(hs_config, USB_SCD_SELF_POWERED, 100, NULL);
USBD_DEVICE_DEFINE(astrial_usbd, DEVICE_DT_GET(DT_NODELABEL(zephyr_udc0)),
		   CONFIG_ASTRIAL_USB_VID, CONFIG_ASTRIAL_USB_PID);

#define TRY(expr) do { int rc = (expr); if (rc != 0) { \
	LOG_ERR("%s failed: %d", #expr, rc); return rc; } } while (0)

static void usb_message(struct usbd_context *const ctx,
			const struct usbd_msg *const msg)
{
	LOG_INF("USBD message: %s", usbd_msg_type_string(msg->type));
	if (msg->type == USBD_MSG_VBUS_READY) {
		int rc = usbd_enable(ctx);
		if (rc != 0 && rc != -EALREADY) {
			LOG_ERR("usbd_enable failed: %d", rc);
		}
	} else if (msg->type == USBD_MSG_VBUS_REMOVED) {
		(void)usbd_disable(ctx);
	}
}

int main(void)
{
	TRY(usbd_add_descriptor(&astrial_usbd, &lang));
	TRY(usbd_add_descriptor(&astrial_usbd, &mfg));
	TRY(usbd_add_descriptor(&astrial_usbd, &product));

	if (USBD_SUPPORTS_HIGH_SPEED &&
	    usbd_caps_speed(&astrial_usbd) == USBD_SPEED_HS) {
		TRY(usbd_add_configuration(&astrial_usbd, USBD_SPEED_HS,
					   &hs_config));
		TRY(usbd_register_class(&astrial_usbd, "astrial_echo_0",
					USBD_SPEED_HS, 1));
		TRY(usbd_device_set_code_triple(&astrial_usbd, USBD_SPEED_HS,
						0, 0, 0));
	} else {
		LOG_ERR("high-speed USB controller required");
		return -ENOTSUP;
	}

	TRY(usbd_add_configuration(&astrial_usbd, USBD_SPEED_FS, &fs_config));
	TRY(usbd_register_class(&astrial_usbd, "astrial_echo_0",
				USBD_SPEED_FS, 1));
	TRY(usbd_device_set_code_triple(&astrial_usbd, USBD_SPEED_FS, 0, 0, 0));
	TRY(usbd_msg_register_cb(&astrial_usbd, usb_message));
	TRY(usbd_init(&astrial_usbd));

	/* MCX EHCI may not report VBUS_READY when J11 was connected at boot. */
	int rc = usbd_enable(&astrial_usbd);
	if (rc != 0 && rc != -EALREADY) {
		LOG_ERR("usbd_enable failed: %d", rc);
		return rc;
	}
	LOG_INF("bulk echo ready: %04x:%04x", CONFIG_ASTRIAL_USB_VID,
		CONFIG_ASTRIAL_USB_PID);
	return 0;
}
```

## src/bulk_echo.c
```c
/* SPDX-License-Identifier: MIT */

#include <string.h>
#include <zephyr/drivers/usb/udc.h>
#include <zephyr/kernel.h>
#include <zephyr/logging/log.h>
#include <zephyr/net_buf.h>
#include <zephyr/sys/atomic.h>
#include <zephyr/sys/byteorder.h>
#include <zephyr/usb/usbd.h>

#include "../protocol.h"

LOG_MODULE_REGISTER(astrial_bulk_echo, LOG_LEVEL_INF);

#define BULK_OUT 0x01
#define BULK_IN  0x81
#define CHUNK_SIZE 4096

struct echo_descriptors {
	struct usb_if_descriptor iface;
	struct usb_ep_descriptor out_fs;
	struct usb_ep_descriptor in_fs;
	struct usb_ep_descriptor out_hs;
	struct usb_ep_descriptor in_hs;
	struct usb_desc_header end;
};

static struct echo_descriptors descriptors = {
	.iface = {
		.bLength = sizeof(struct usb_if_descriptor),
		.bDescriptorType = USB_DESC_INTERFACE,
		.bInterfaceNumber = 0,
		.bAlternateSetting = 0,
		.bNumEndpoints = 2,
		.bInterfaceClass = USB_BCC_VENDOR,
	},
	.out_fs = {
		.bLength = sizeof(struct usb_ep_descriptor),
		.bDescriptorType = USB_DESC_ENDPOINT,
		.bEndpointAddress = BULK_OUT,
		.bmAttributes = USB_EP_TYPE_BULK,
		.wMaxPacketSize = sys_cpu_to_le16(64),
	},
	.in_fs = {
		.bLength = sizeof(struct usb_ep_descriptor),
		.bDescriptorType = USB_DESC_ENDPOINT,
		.bEndpointAddress = BULK_IN,
		.bmAttributes = USB_EP_TYPE_BULK,
		.wMaxPacketSize = sys_cpu_to_le16(64),
	},
	.out_hs = {
		.bLength = sizeof(struct usb_ep_descriptor),
		.bDescriptorType = USB_DESC_ENDPOINT,
		.bEndpointAddress = BULK_OUT,
		.bmAttributes = USB_EP_TYPE_BULK,
		.wMaxPacketSize = sys_cpu_to_le16(512),
	},
	.in_hs = {
		.bLength = sizeof(struct usb_ep_descriptor),
		.bDescriptorType = USB_DESC_ENDPOINT,
		.bEndpointAddress = BULK_IN,
		.bmAttributes = USB_EP_TYPE_BULK,
		.wMaxPacketSize = sys_cpu_to_le16(512),
	},
	.end = { .bLength = 0 },
};

static const struct usb_desc_header *const fs_desc[] = {
	(struct usb_desc_header *)&descriptors.iface,
	(struct usb_desc_header *)&descriptors.out_fs,
	(struct usb_desc_header *)&descriptors.in_fs,
	(struct usb_desc_header *)&descriptors.end,
};
static const struct usb_desc_header *const hs_desc[] = {
	(struct usb_desc_header *)&descriptors.iface,
	(struct usb_desc_header *)&descriptors.out_hs,
	(struct usb_desc_header *)&descriptors.in_hs,
	(struct usb_desc_header *)&descriptors.end,
};

static atomic_t enabled;

static int queue_out(struct usbd_class_data *c_data, struct net_buf *buf)
{
	int rc;
	if (!atomic_get(&enabled)) {
		net_buf_unref(buf);
		return 0;
	}
	net_buf_reset(buf);
	udc_get_buf_info(buf)->ep = BULK_OUT;
	rc = usbd_ep_enqueue(c_data, buf);
	if (rc != 0) {
		LOG_ERR("queue OUT failed: %d", rc);
		net_buf_unref(buf);
	}
	return rc;
}

static int new_out(struct usbd_class_data *c_data)
{
	struct net_buf *buf = usbd_ep_buf_alloc(c_data, BULK_OUT, CHUNK_SIZE);
	if (buf == NULL) {
		LOG_ERR("OUT buffer allocation failed");
		return -ENOMEM;
	}
	return queue_out(c_data, buf);
}

static int request_done(struct usbd_class_data *c_data,
			struct net_buf *buf, int err)
{
	struct udc_buf_info *info = udc_get_buf_info(buf);
	uint8_t ep = info->ep;
	int rc;

	if (err != 0) {
		net_buf_unref(buf);
		if (atomic_get(&enabled)) {
			LOG_ERR("transfer 0x%02x failed: %d", ep, err);
			return new_out(c_data);
		}
		return 0;
	}

	if (ep == BULK_OUT && buf->len != 0) {
		if (buf->len >= ASTRIAL_USB_TIMING_HEADER_SIZE &&
		    memcmp(buf->data, ASTRIAL_USB_TIMING_MAGIC,
			   ASTRIAL_USB_TIMING_MAGIC_SIZE) == 0) {
			uint64_t out_cycles = k_cycle_get_64();
			sys_put_le64(out_cycles, buf->data + 8);
			sys_put_le32(CONFIG_SYS_CLOCK_HW_CYCLES_PER_SEC,
				     buf->data + 24);
			sys_put_le32(ASTRIAL_USB_TIMING_VERSION,
				     buf->data + 28);
			sys_put_le64(k_cycle_get_64(), buf->data + 16);
		}
		/* Return exactly the bytes received; the host checks every byte. */
		info->ep = BULK_IN;
		rc = usbd_ep_enqueue(c_data, buf);
		if (rc == 0) {
			return 0;
		}
		LOG_ERR("queue IN failed: %d", rc);
		net_buf_unref(buf);
		return new_out(c_data);
	}

	return queue_out(c_data, buf);
}

static void enable(struct usbd_class_data *c_data)
{
	atomic_set(&enabled, 1);
	(void)new_out(c_data);
}

static void disable(struct usbd_class_data *c_data)
{
	ARG_UNUSED(c_data);
	atomic_clear(&enabled);
}

static const void *get_desc(struct usbd_class_data *c_data,
			    enum usbd_speed speed)
{
	ARG_UNUSED(c_data);
	return speed == USBD_SPEED_HS ? hs_desc : fs_desc;
}

static int init(struct usbd_class_data *c_data)
{
	ARG_UNUSED(c_data);
	return 0;
}

static const struct usbd_class_api echo_api = {
	.request = request_done,
	.enable = enable,
	.disable = disable,
	.init = init,
	.get_desc = get_desc,
};

USBD_DEFINE_CLASS(astrial_echo_0, &echo_api, NULL, NULL);
```
