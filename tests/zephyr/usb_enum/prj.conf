## CMakeLists.txt
```
# SPDX-License-Identifier: MIT

cmake_minimum_required(VERSION 3.20.0)
find_package(Zephyr REQUIRED HINTS $ENV{ZEPHYR_BASE})
project(astrial_usb_enum)

target_sources(app PRIVATE src/main.c)
```

## Kconfig
```
# SPDX-License-Identifier: MIT

# Application-level Kconfig for the Astrial USB enumeration firmware.
# Deliberately self-contained: this app does not use the Zephyr tree's
# samples/subsys/usb/common Kconfig (sample_usbd).

menu "Astrial USB test options"
	depends on USB_DEVICE_STACK_NEXT

config ASTRIAL_USB_VID
	hex "USB Vendor ID"
	default 0x2fe3
	help
	  Vendor ID the firmware enumerates with. The astrial HIL tools
	  default to 0x2fe3:0x574c, so keep these in sync unless you have
	  a reason not to. 0x2fe3 is the Zephyr Project VID: acceptable
	  for a lab fixture, never for anything that ships.

config ASTRIAL_USB_PID
	hex "USB Product ID"
	default 0x574c
	help
	  Product ID the firmware enumerates with. Match the default of
	  tests/usb_lifecycle_hil.

config ASTRIAL_USB_MANUFACTURER
	string "Manufacturer string"
	default "Astrial"

config ASTRIAL_USB_PRODUCT
	string "Product string"
	default "Astrial USB Bulk Test"

endmenu

source "Kconfig.zephyr"
```

## prj.conf
```kconfig
# SPDX-License-Identifier: MIT

# New (device_next) USB device stack. The legacy stack is deprecated on
# Zephyr main and lacks the HS path used here.
CONFIG_USB_DEVICE_STACK_NEXT=y

# Built-in loopback class: interface 0, vendor class, bulk OUT 0x01 and
# bulk IN 0x81 -- the exact layout astrial::usb selects by default.
# Not sample code; it ships with the device stack itself.
CONFIG_USBD_LOOPBACK_CLASS=y

# MCXN947 has an EHCI controller with on-chip HS PHY. Make High Speed
# explicit instead of relying on the driver-implied default.
CONFIG_USBD_MAX_SPEED_HIGH=y

# Room for several in-flight transfers. The default of 1024 bytes is too
# small for 512-byte HS bulk packets; raise further for the throughput
# benchmarks later.
CONFIG_UDC_BUF_POOL_SIZE=8192

CONFIG_LOG=y
```

## src/main.c
```c
/*
 * SPDX-License-Identifier: MIT
 *
 * Astrial USB enumeration-check firmware for FRDM-MCXN947.
 *
 * Enumerates the on-chip HS USB controller as a vendor device using the
 * device_next stack and the built-in loopback class so that:
 *
 *   - the host-side enumeration check can confirm VID/PID, bus speed and
 *     endpoint layout (lsusb / dmesg), and
 *   - astrial::usb finds the interface it expects by default
 *     (interface 0, vendor class, bulk OUT 0x01 / bulk IN 0x81).
 *
 * Deliberately self-contained: this file does not use the Zephyr tree's
 * samples/subsys/usb/common helpers.
 */

#include <zephyr/kernel.h>
#include <zephyr/logging/log.h>
#include <zephyr/usb/usbd.h>
#include <errno.h>

LOG_MODULE_REGISTER(astrial_usb_enum, LOG_LEVEL_INF);

USBD_DESC_LANG_DEFINE(lang);
USBD_DESC_MANUFACTURER_DEFINE(mfg, CONFIG_ASTRIAL_USB_MANUFACTURER);
USBD_DESC_PRODUCT_DEFINE(product, CONFIG_ASTRIAL_USB_PRODUCT);

USBD_CONFIGURATION_DEFINE(fs_config, USB_SCD_SELF_POWERED, 100, NULL);
USBD_CONFIGURATION_DEFINE(hs_config, USB_SCD_SELF_POWERED, 100, NULL);

USBD_DEVICE_DEFINE(astrial_usbd,
		   DEVICE_DT_GET(DT_NODELABEL(zephyr_udc0)),
		   CONFIG_ASTRIAL_USB_VID,
		   CONFIG_ASTRIAL_USB_PID);

#define ASTRIAL_TRY(expr)                                                       \
	do {                                                                    \
		int _err = (expr);                                              \
		if (_err != 0) {                                                \
			LOG_ERR("%s failed: %d", #expr, _err);                  \
			return _err;                                            \
		}                                                               \
	} while (0)

static void enum_msg_cb(struct usbd_context *const ctx,
			const struct usbd_msg *const msg)
{
	LOG_INF("USBD message: %s", usbd_msg_type_string(msg->type));

	if (!usbd_can_detect_vbus(ctx)) {
		return;
	}

	/* Controller reports VBUS state: enable/disable with the cable. */
	if (msg->type == USBD_MSG_VBUS_READY) {
		int err = usbd_enable(ctx);

		if (err != 0 && err != -EALREADY) {
			LOG_ERR("usbd_enable failed: %d", err);
		}
	}

	if (msg->type == USBD_MSG_VBUS_REMOVED) {
		(void)usbd_disable(ctx);
	}
}

int main(void)
{
	ASTRIAL_TRY(usbd_add_descriptor(&astrial_usbd, &lang));
	ASTRIAL_TRY(usbd_add_descriptor(&astrial_usbd, &mfg));
	ASTRIAL_TRY(usbd_add_descriptor(&astrial_usbd, &product));

	/*
	 * Zephyr's loopback class exposes three vendor interfaces under an IAD.
	 * Interface 0 carries the bulk endpoints used by astrial::usb. Keep
	 * the device-level class code at zero so the host reads the interface
	 * descriptors for the function class.
	 */
	if (USBD_SUPPORTS_HIGH_SPEED &&
	    usbd_caps_speed(&astrial_usbd) == USBD_SPEED_HS) {
		LOG_INF("UDC capability: high-speed");
		ASTRIAL_TRY(usbd_add_configuration(&astrial_usbd, USBD_SPEED_HS,
						   &hs_config));
		ASTRIAL_TRY(usbd_register_class(&astrial_usbd, "loopback_0",
						USBD_SPEED_HS, 1));
		ASTRIAL_TRY(usbd_device_set_code_triple(&astrial_usbd,
							USBD_SPEED_HS, 0, 0, 0));
	} else {
		LOG_INF("UDC capability: full-speed only");
	}

	ASTRIAL_TRY(usbd_add_configuration(&astrial_usbd, USBD_SPEED_FS,
					   &fs_config));
	ASTRIAL_TRY(usbd_register_class(&astrial_usbd, "loopback_0",
					USBD_SPEED_FS, 1));
	ASTRIAL_TRY(usbd_device_set_code_triple(&astrial_usbd, USBD_SPEED_FS,
						0, 0, 0));

	ASTRIAL_TRY(usbd_msg_register_cb(&astrial_usbd, enum_msg_cb));
	ASTRIAL_TRY(usbd_init(&astrial_usbd));

	/* The EHCI driver may miss VBUS_READY when J11 is already connected. */
	int err = usbd_enable(&astrial_usbd);

	if (err != 0 && err != -EALREADY) {
		LOG_ERR("usbd_enable failed: %d", err);
		return err;
	}
	LOG_INF("USB device support enabled");

	LOG_INF("Astrial USB enum check ready: %04x:%04x",
		CONFIG_ASTRIAL_USB_VID, CONFIG_ASTRIAL_USB_PID);
	return 0;
}
```
